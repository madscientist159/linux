## Documentation/devicetree/bindings/leds/leds-pca955x.txt
```
*NXP - pca955x PWM LED Driver

The PCA955x family are SMBus I/O expanders optimized for blinking LEDs.

Required properties:
	- compatible:
		"nxp,pca9550"
		"nxp,pca9551"
		"nxp,pca9552"
		"nxp,pca9553"
	- reg -  I2C slave address

Each led is represented as a sub-node of the nxp,pca955x.

Optional sub-node properties:
	- label: see Documentation/devicetree/bindings/leds/common.txt
	- linux,default-trigger: see Documentation/devicetree/bindings/leds/common.txt

Example:
  #include <dt-bindings/leds/leds-pca955x.h>

  leds: pca955x@60 {
    compatible = "nxp,pca9530";
    reg = <0x60>;

    red-power {
      label = "pca:red:power";
    };
    green-power {
      label = "pca:green:power";
    };
  };

For more product information please see the link below:
http://nxp.com/documents/data_sheet/PCA9552.pdf
```

## Documentation/devicetree/bindings/pinctrl/pinctrl-aspeed.txt
```
Aspeed Pin Controllers
----------------------

The Aspeed SoCs vary in functionality inside a generation but have a common mux
device register layout.

Required properties:
- compatible: should be one of the following:
	"aspeed,g4-pinctrl";
	"aspeed,g5-pinctrl"

The pin controller node should be a child of a syscon node with the required
property:
- compatible: "syscon", "simple-mfd"

Refer to the the bindings described in
Documentation/devicetree/bindings/mfd/syscon.txt

Subnode format:

Please refer to pinctrl-bindings.txt in this directory for details of the
common pinctrl bindings used by client devices.

The required properties of child nodes are (as defined in pinctrl-bindings):
- function
- groups

Each function has only one associated pin group. Each group is named by its
function.

Examples:

syscon: scu@1e6e2000 {
	compatible = "syscon", "simple-mfd";
	reg = <0x1e6e2000 0x1a8>;

	pinctrl: pinctrl@1e6e2000 {
		compatible = "aspeed,g4-pinctrl";

		pinctrl_i2c3_default: i2c3_default {
			function = "I2C3";
			groups = "I2C3";
		};
	};
};
```
